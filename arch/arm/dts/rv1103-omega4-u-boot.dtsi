/*
 * (C) Copyright 2024 Rockchip Electronics Co., Ltd
 *
 * SPDX-License-Identifier:     GPL-2.0+
 */

#include "rockchip-u-boot.dtsi"

 / {
	chosen {
		stdout-path = &uart0;
		u-boot,spl-boot-order = &spi_nand;
	};
};
