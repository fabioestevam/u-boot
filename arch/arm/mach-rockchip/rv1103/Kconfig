## arch/arm/mach-rockchip/rv1103/Kconfig
```kconfig
if ROCKCHIP_RV1103

choice
	prompt "RV1103 board select"

config TARGET_EVB_RV1103B
	bool "EVB_RV1103B"
	help
	  RV1103B EVB is a evaluation board for Rockchip RV1103B.

endchoice

config ROCKCHIP_BOOT_MODE_REG
	default 0x20160200

config ROCKCHIP_STIMER_BASE
	default 0x20500000

config SYS_SOC
	default "rv1103"

config SYS_MALLOC_F_LEN
	default 0x400

source "board/rockchip/evb_rv1103b/Kconfig"
endif
```

## configs/evb-rv1103_defconfig
```kconfig
CONFIG_ARM=y
CONFIG_SKIP_LOWLEVEL_INIT=y
CONFIG_ARCH_ROCKCHIP=y
CONFIG_TEXT_BASE=0x00000000
CONFIG_NR_DRAM_BANKS=1
CONFIG_HAS_CUSTOM_SYS_INIT_SP_ADDR=y
CONFIG_CUSTOM_SYS_INIT_SP_ADDR=0x00100000
CONFIG_DEFAULT_DEVICE_TREE="rv1103b-evb1"
CONFIG_ROCKCHIP_RV1103=y
CONFIG_ROCKCHIP_BOOT_MODE_REG=0
CONFIG_SYS_LOAD_ADDR=0x02000000
CONFIG_DEBUG_UART_BASE=0x20540000
CONFIG_DEBUG_UART_CLOCK=24000000
# CONFIG_DEBUG_UART_BOARD_INIT is not set
CONFIG_DEBUG_UART=y
# CONFIG_USE_BOOTCOMMAND is not set
# CONFIG_DISPLAY_CPUINFO is not set
CONFIG_DISPLAY_BOARDINFO_LATE=y
CONFIG_BOARD_EARLY_INIT_F=y
CONFIG_BOARD_LATE_INIT=y
CONFIG_CMD_GPIO=y
CONFIG_CMD_MMC=y
# CONFIG_CMD_SETEXPR is not set
CONFIG_CMD_CACHE=y
CONFIG_CMD_TIME=y
CONFIG_ENV_RELOC_GD_ENV_ADDR=y
CONFIG_REGMAP=y
CONFIG_SYSCON=y
CONFIG_CLK=y
CONFIG_ROCKCHIP_GPIO=y
CONFIG_SYS_I2C_ROCKCHIP=y
CONFIG_MMC_DW=y
CONFIG_MMC_DW_ROCKCHIP=y
CONFIG_PINCTRL=y
CONFIG_PINCTRL_ROCKCHIP_RV1103=y
CONFIG_DM_REGULATOR_FIXED=y
CONFIG_DEBUG_UART_SHIFT=2
CONFIG_SYS_NS16550_MEM32=y
CONFIG_SYSRESET=y
CONFIG_ERRNO_STR=y
```
